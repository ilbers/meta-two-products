## meta-common/conf/bblayers.conf.sample
```bitbake
# LAYER_CONF_VERSION is increased each time build/conf/bblayers.conf
# changes incompatibly
LCONF_VERSION = "6"

BBPATH = "${TOPDIR}"
BBFILES ?= ""

BBLAYERS ?= " \
  ##ISARROOT##/meta \
  ##ISARROOT##/meta-two-products/meta-common \
  ##ISARROOT##/meta-two-products/meta-product-a \
  ##ISARROOT##/meta-two-products/meta-product-b \
  "
BBLAYERS_NON_REMOVABLE ?= " \
  ##ISARROOT##/meta \
  "
```

## meta-common/conf/layer.conf
```bitbake
# This software is a part of ISAR.
# Copyright (C) 2015-2016 ilbers GmbH
#
# This is example layer, that contains common artifacts
# for products A and B.

# We have a conf and classes directory, add to BBPATH
BBPATH .= ":${LAYERDIR}"

# We have recipes-* directories, add to BBFILES
BBFILES +=  "${LAYERDIR}/recipes-*/*/*.bb"

BBFILE_COLLECTIONS += "common"
BBFILE_PATTERN_common = "^${LAYERDIR}/"
BBFILE_PRIORITY_common = "5"

# This should only be incremented on significant changes that will
# cause compatibility issues with other layers
LAYERVERSION_common = "1"

LAYERDIR_common = "${LAYERDIR}"
```

## meta-product-a/conf/layer.conf
```bitbake
# This software is a part of ISAR.
# Copyright (C) 2015-2016 ilbers GmbH
#
# This is example layer, that contains product A recipes.

# We have a conf and classes directory, add to BBPATH
BBPATH .= ":${LAYERDIR}"

# We have recipes-* directories, add to BBFILES
BBFILES +=  "${LAYERDIR}/recipes-*/*/*.bb"

BBFILE_COLLECTIONS += "a"
BBFILE_PATTERN_a = "^${LAYERDIR}/"
BBFILE_PRIORITY_a = "5"

# This should only be incremented on significant changes that will
# cause compatibility issues with other layers
LAYERVERSION_a = "1"

LAYERDIR_a = "${LAYERDIR}"
```

## meta-product-b/conf/layer.conf
```bitbake
# This software is a part of ISAR.
# Copyright (C) 2015-2016 ilbers GmbH
#
# This is example layer, that contains product B recipes.

# We have a conf and classes directory, add to BBPATH
BBPATH .= ":${LAYERDIR}"

# We have recipes-* directories, add to BBFILES
BBFILES +=  "${LAYERDIR}/recipes-*/*/*.bb"

BBFILE_COLLECTIONS += "b"
BBFILE_PATTERN_b = "^${LAYERDIR}/"
BBFILE_PRIORITY_b = "5"

# This should only be incremented on significant changes that will
# cause compatibility issues with other layers
LAYERVERSION_b = "1"

LAYERDIR_b = "${LAYERDIR}"
```
